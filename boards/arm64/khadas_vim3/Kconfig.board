## boards/arm64/khadas_vim3/Kconfig.board
```kconfig
#
# Copyright 2022 Huawei France Technologies SASU
# SPDX-License-Identifier: Apache-2.0
#

config BOARD_KHADAS_VIM3
	bool "Khadas VIM3"
	depends on SOC_SERIES_A311D
```

## boards/arm64/khadas_vim3/Kconfig.defconfig
```kconfig
#
# Copyright 2022 Huawei France Technologies SASU
# SPDX-License-Identifier: Apache-2.0
#

config BOARD
	default "khadas_vim3"
	depends on BOARD_KHADAS_VIM3
```

## dts/bindings/clock/amlogic,g12a-clkc.yaml
```yaml
description: Amlogic DDR Clock Controller Device Tree Bindings

compatible: "amlogic,g12a-clkc"
include: base.yaml
properties:

  clocks:
    required: true

  clock-names:
    required: true

  "#clock-cells":
    type: int
```

## dts/bindings/clock/amlogic,meson-axg-aoclkc.yaml
```yaml
description: Amlogic DDR Clock Controller Device Tree Bindings

compatible: "amlogic,meson-axg-aoclkc"
include: base.yaml
properties:

  clocks:
    required: true

  clock-names:
    required: true

  "#clock-cells":
    required: true
    type: int


  "#reset-cells":
    required: true
    type: int
```

## dts/bindings/cpu/arm,cortex-a73.yaml
```yaml
# SPDX-License-Identifier: Apache-2.0

description: This is a representation of ARM Cortex-A73 CPU.

compatible: "arm,cortex-a73"

include: cpu.yaml
```

## dts/bindings/pinctrl/amlogic,meson-axg-aobus-pinctrl.yaml
```yaml
# Copyright (c) 2021 Teslabs Engineering S.L.
# SPDX-License-Identifier: Apache-2.0

description: |
  Amlogic Meson pinmux controller

compatible: "amlogic,meson-axg-aobus-pinctrl"

include: base.yaml
```

## dts/bindings/serial/amlogic,meson-ao-uart.yaml
```yaml
description: Amlogic UART

compatible: amlogic,meson-ao-uart

include: uart-controller.yaml

properties:
    interrupts:
      required: true

    reg-shift:
      type: int
      required: true
      description: quantity to shift the register offsets by
```

## soc/arm64/amlogic/Kconfig
```kconfig
#
# Copyright 2021 Huawei France Technologies SASU
#
# SPDX-License-Identifier: Apache-2.0
#

config SOC_FAMILY_AMLOGIC
	bool

if SOC_FAMILY_AMLOGIC

config SOC_FAMILY
	string
	default "amlogic"

source "soc/arm64/amlogic/*/Kconfig.soc"

config SOC_PART_NUMBER
	default "a311d" if SOC_SERIES_A311D

endif # SOC_FAMILY_ROCKCHIP
```

## soc/arm64/amlogic/Kconfig.defconfig
```kconfig
#
# Copyright 2021 Huawei France Technologies SASU
#
# SPDX-License-Identifier: Apache-2.0
#

source "soc/arm64/amlogic/*/Kconfig.defconfig.series"
```

## soc/arm64/amlogic/a311d/Kconfig.defconfig.a311d
```kconfig
#
# Copyright 2022 Huawei France Technologies SASU
#
# SPDX-License-Identifier: Apache-2.0
#

if SOC_A311D

config SOC
	default "a311d"

config NUM_IRQS
	int
	default 240

config FLASH_SIZE
	default 0

config FLASH_BASE_ADDRESS
	default 0

endif
```

## soc/arm64/amlogic/a311d/Kconfig.defconfig.series
```kconfig
#
# Copyright 2022 Huawei France Technologies SASU
#
# SPDX-License-Identifier: Apache-2.0
#

if SOC_SERIES_A311D

config SOC_SERIES
	default "a311d"

source "soc/arm64/amlogic/a311d/Kconfig.defconfig.a311d"

endif # SOC_SERIES_A311D
```

## soc/arm64/amlogic/a311d/Kconfig.series
```kconfig
#
# Copyright 2022 Huawei France Technologies SASU
#
# SPDX-License-Identifier: Apache-2.0
#

config SOC_SERIES_A311D
	bool "Rockchip A311D Series"
	select ARM64
	select SOC_FAMILY_AMLOGIC
	help
	  Enable support for Amlogic A311D Series.
```

## soc/arm64/amlogic/a311d/Kconfig.soc
```kconfig
#
# Copyright 2022 Huawei France Technologies SASU
#
# SPDX-License-Identifier: Apache-2.0
#

choice
prompt "Amlogic A311D SoC"
depends on SOC_SERIES_A311D

config SOC_A311D
	bool "Amlogic A311D"
	select ARM64
	select CPU_CORTEX_A53
	select ARM_ARCH_TIMER if SYS_CLOCK_EXISTS

endchoice
```
