/ {
    chosen {
       zephyr,console = &uart0;
       zephyr,shell-uart = &uart0;
       zephyr,bt-c2h-uart = &uart1;
    };
 };
&uart1 {
    status = "okay";
    current-speed = <115200>;
    pinctrl-0 = <&uart1_default>;
    pinctrl-1 = <&uart1_sleep>;
    pinctrl-names = "default", "sleep";
};
uart1_default: uart1_default {
        group1 {
            psels = <NRF_PSEL(UART_RX, 1, 12)>,
                <NRF_PSEL(UART_TX, 1, 13)>;
        };
    };

    uart1_sleep: uart1_sleep {
        group1 {
            psels = <NRF_PSEL(UART_RX, 1, 12)>,
                <NRF_PSEL(UART_TX, 1, 13)>;
            low-power-enable;
        };
    };